## conf/layer.conf
```bitbake
# We have a conf and classes directory, add to BBPATH
BBPATH .= ":${LAYERDIR}"

# We have recipes-* directories, add to BBFILES
BBFILES += "${LAYERDIR}/recipes-*/*/*.bb \
            ${LAYERDIR}/recipes-*/*/*.bbappend"

BBFILE_COLLECTIONS += "meta-phytec"
BBFILE_PATTERN_meta-phytec = "^${LAYERDIR}/"
BBFILE_PRIORITY_meta-phytec = "20"

LAYERDEPENDS_meta-phytec = "core"
LAYERSERIES_COMPAT_meta-phytec = "thud"

PHYCORE_STM32MP_BASE = "${LAYERDIR}"
```
